## conf/bblayers.conf
```bitbake
# Layer stack for the Radxa Zero RuView fleet build.
# Adjust the base path to wherever you cloned the upstream layers (see README).
# Only meta-ruview lives in THIS repo; the rest are upstream clones.

BBLAYERS ?= " \
  /opt/yocto/radxa-fleet/poky/meta \
  /opt/yocto/radxa-fleet/poky/meta-poky \
  /opt/yocto/radxa-fleet/meta-oe/meta-oe \
  /opt/yocto/radxa-fleet/meta-oe/meta-filesystems \
  /opt/yocto/radxa-fleet/meta-oe/meta-networking \
  /opt/yocto/radxa-fleet/meta-oe/meta-python \
  /opt/yocto/radxa-fleet/meta-meson \
  /opt/yocto/radxa-fleet/meta-rauc \
  /opt/yocto/radxa-fleet/meta-virtualization \
  /opt/yocto/radxa-fleet/meta-ruview \
  "
```

## conf/local.conf
```bitbake
# Radxa Zero RuView fleet — Yocto local.conf (scarthgap)
# Sample/reference. Copy to build/conf/local.conf and set the secrets below
# via environment (do NOT commit real secrets to this repo).

MACHINE = "radxa-zero"
DISTRO = "poky"
PACKAGE_CLASSES = "package_ipk"

DISTRO_FEATURES:append = " systemd rauc usrmerge virtualization"
VIRTUAL-RUNTIME_init_manager = "systemd"
DISTRO_FEATURES_BACKFILL_CONSIDERED = "sysvinit"

BB_NUMBER_THREADS = "14"
PARALLEL_MAKE = "-j 14"

IMAGE_FEATURES:append = " ssh-server-openssh"
IMAGE_FEATURES:append = " debug-tweaks"
IMAGE_FSTYPES:append = " ext4"
DEFAULT_TIMEZONE = "America/Los_Angeles"

# --- Core fleet payload ---
IMAGE_INSTALL:append = " rauc rauc-system nm-config ssh-keys networkmanager networkmanager-nmcli curl python3"
IMAGE_INSTALL:append = " docker-moby containerd-opencontainers runc-opencontainers"
IMAGE_INSTALL:append = " chrony"

# --- S125 fleet fixes (see README / docs) ---
IMAGE_INSTALL:append = " firmware-radxa-wifi"   # BCM43456/AP6256 WiFi+BT (chip is NOT 43430)
IMAGE_INSTALL:append = " kernel-modules"         # pwm-meson/brcmfmac etc. (core-image-minimal omits these)
IMAGE_INSTALL:append = " iproute2"               # `ip`
IMAGE_INSTALL:append = " coreutils"              # `timeout` (ssh-manager wraps commands), full utils

# --- RAUC signing (keys live outside the repo) ---
RAUC_KEYRING_FILE   = "${TOPDIR}/../rauc-keys/development-1.cert.pem"
RAUC_SIGNING_KEYFILE  = "${TOPDIR}/../rauc-keys/development-1.key.pem"
RAUC_SIGNING_CERTFILE = "${TOPDIR}/../rauc-keys/development-1.cert.pem"

# --- SECRETS: provide via environment / out-of-band, never hardcode here ---
# Export MANGO_WPA_PSK before building (e.g. from OpenBao).
MANGO_WPA_PSK = "${@os.environ.get('MANGO_WPA_PSK', 'CHANGEME_EXPORT_MANGO_WPA_PSK')}"

# `rock` login user. Generate a real hash:  openssl passwd -6   (or mkpasswd -m sha-512)
INHERIT += "extrausers"
EXTRA_USERS_PARAMS = "useradd -m -s /bin/sh -G sudo rock; usermod -p 'REPLACE_WITH_SHA512_CRYPT_HASH' rock;"

BAD_RECOMMENDATIONS:append = " rauc-conf"
HOSTTOOLS:append = " qemu-x86_64"

# Host-specific paths — adjust for your build host
DL_DIR = "/opt/yocto/downloads"
SSTATE_DIR = "/opt/yocto/sstate-cache"
```

## meta-ruview/conf/layer.conf
```bitbake
BBPATH .= ":${LAYERDIR}"
BBFILES += "${LAYERDIR}/recipes-*/*/*.bb ${LAYERDIR}/recipes-*/*/*.bbappend"
LAYERVERSION_meta-ruview = "1"
LAYERDEPENDS_meta-ruview = "core"
LAYERSERIES_COMPAT_meta-ruview = "scarthgap"
```
